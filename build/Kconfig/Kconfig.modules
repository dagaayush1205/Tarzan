## build/Kconfig/Kconfig.modules
```kconfig
menu "Kyvernitis (/home/ayushd/R2-D2_workspace/modules/lib/kyvernitis)"
osource "/home/ayushd/R2-D2_workspace/modules/lib/kyvernitis/zephyr/Kconfig"
config ZEPHYR_KYVERNITIS_MODULE
	bool
	default y
endmenu
menu "cmsis (/home/ayushd/R2-D2_workspace/modules/hal/cmsis)"
osource "$(ZEPHYR_CMSIS_KCONFIG)"
config ZEPHYR_CMSIS_MODULE
	bool
	default y
endmenu
config ZEPHYR_STM32_MODULE
   bool
   default y
menu "canard (/home/ayushd/R2-D2_workspace/modules/lib/canard)"
osource "/home/ayushd/R2-D2_workspace/modules/lib/canard/zephyr/Kconfig"
config ZEPHYR_CANARD_MODULE
	bool
	default y
endmenu
menu "CANscribe (/home/ayushd/R2-D2_workspace/modules/lib/canscribe)"
osource "/home/ayushd/R2-D2_workspace/modules/lib/canscribe/zephyr/Kconfig"
config ZEPHYR_CANSCRIBE_MODULE
	bool
	default y
endmenu
```

## build/Kconfig/Kconfig.sysbuild.modules
```kconfig
config ZEPHYR_KYVERNITIS_MODULE
   bool
   default y
config ZEPHYR_CMSIS_MODULE
   bool
   default y
config ZEPHYR_STM32_MODULE
   bool
   default y
config ZEPHYR_CANARD_MODULE
   bool
   default y
config ZEPHYR_CANSCRIBE_MODULE
   bool
   default y
```

## build/Kconfig/arch/Kconfig
```kconfig
# Load arch Kconfig descriptions.
osource "/home/ayushd/R2-D2_workspace/zephyr/arch/x86/Kconfig"
osource "/home/ayushd/R2-D2_workspace/zephyr/arch/xtensa/Kconfig"
osource "/home/ayushd/R2-D2_workspace/zephyr/arch/sparc/Kconfig"
osource "/home/ayushd/R2-D2_workspace/zephyr/arch/riscv/Kconfig"
osource "/home/ayushd/R2-D2_workspace/zephyr/arch/posix/Kconfig"
osource "/home/ayushd/R2-D2_workspace/zephyr/arch/nios2/Kconfig"
osource "/home/ayushd/R2-D2_workspace/zephyr/arch/mips/Kconfig"
osource "/home/ayushd/R2-D2_workspace/zephyr/arch/arm64/Kconfig"
osource "/home/ayushd/R2-D2_workspace/zephyr/arch/arm/Kconfig"
osource "/home/ayushd/R2-D2_workspace/zephyr/arch/arc/Kconfig"
```

## build/Kconfig/soc/Kconfig
```kconfig
# Load Zephyr SoC Kconfig descriptions.
osource "/home/ayushd/R2-D2_workspace/zephyr/soc/xlnx/zynqmp/Kconfig"
osource "/home/ayushd/R2-D2_workspace/zephyr/soc/xlnx/zynq7000/Kconfig"
osource "/home/ayushd/R2-D2_workspace/zephyr/soc/xen/Kconfig"
osource "/home/ayushd/R2-D2_workspace/zephyr/soc/ti/simplelink/Kconfig"
osource "/home/ayushd/R2-D2_workspace/zephyr/soc/ti/lm3s6965/Kconfig"
osource "/home/ayushd/R2-D2_workspace/zephyr/soc/ti/k3/Kconfig"
osource "/home/ayushd/R2-D2_workspace/zephyr/soc/telink/tlsr/Kconfig"
osource "/home/ayushd/R2-D2_workspace/zephyr/soc/starfive/jh71xx/Kconfig"
osource "/home/ayushd/R2-D2_workspace/zephyr/soc/st/stm32/Kconfig"
osource "/home/ayushd/R2-D2_workspace/zephyr/soc/snps/qemu_arc/Kconfig"
osource "/home/ayushd/R2-D2_workspace/zephyr/soc/snps/nsim/arc_v/Kconfig"
osource "/home/ayushd/R2-D2_workspace/zephyr/soc/snps/nsim/arc_classic/Kconfig"
osource "/home/ayushd/R2-D2_workspace/zephyr/soc/snps/hsdk4xd/Kconfig"
osource "/home/ayushd/R2-D2_workspace/zephyr/soc/snps/hsdk/Kconfig"
osource "/home/ayushd/R2-D2_workspace/zephyr/soc/snps/emsk/Kconfig"
osource "/home/ayushd/R2-D2_workspace/zephyr/soc/snps/emsdp/Kconfig"
osource "/home/ayushd/R2-D2_workspace/zephyr/soc/snps/arc_iot/Kconfig"
osource "/home/ayushd/R2-D2_workspace/zephyr/soc/silabs/Kconfig"
osource "/home/ayushd/R2-D2_workspace/zephyr/soc/sifive/sifive_freedom/Kconfig"
osource "/home/ayushd/R2-D2_workspace/zephyr/soc/rockchip/Kconfig"
osource "/home/ayushd/R2-D2_workspace/zephyr/soc/renode/riscv_virtual/Kconfig"
osource "/home/ayushd/R2-D2_workspace/zephyr/soc/renesas/smartbond/Kconfig"
osource "/home/ayushd/R2-D2_workspace/zephyr/soc/renesas/rzt2m/Kconfig"
osource "/home/ayushd/R2-D2_workspace/zephyr/soc/renesas/rcar/Kconfig"
osource "/home/ayushd/R2-D2_workspace/zephyr/soc/renesas/ra/Kconfig"
osource "/home/ayushd/R2-D2_workspace/zephyr/soc/raspberrypi/Kconfig"
osource "/home/ayushd/R2-D2_workspace/zephyr/soc/quicklogic/eos_s3/Kconfig"
osource "/home/ayushd/R2-D2_workspace/zephyr/soc/qemu/virt_riscv/Kconfig"
osource "/home/ayushd/R2-D2_workspace/zephyr/soc/qemu/malta/Kconfig"
osource "/home/ayushd/R2-D2_workspace/zephyr/soc/openisa/rv32m1/Kconfig"
osource "/home/ayushd/R2-D2_workspace/zephyr/soc/nxp/s32/Kconfig"
osource "/home/ayushd/R2-D2_workspace/zephyr/soc/nxp/rw/Kconfig"
osource "/home/ayushd/R2-D2_workspace/zephyr/soc/nxp/mcx/Kconfig"
osource "/home/ayushd/R2-D2_workspace/zephyr/soc/nxp/lpc/Kconfig"
osource "/home/ayushd/R2-D2_workspace/zephyr/soc/nxp/layerscape/Kconfig"
osource "/home/ayushd/R2-D2_workspace/zephyr/soc/nxp/kinetis/Kconfig"
osource "/home/ayushd/R2-D2_workspace/zephyr/soc/nxp/imxrt/Kconfig"
osource "/home/ayushd/R2-D2_workspace/zephyr/soc/nxp/imx/Kconfig"
osource "/home/ayushd/R2-D2_workspace/zephyr/soc/nuvoton/numicro/Kconfig"
osource "/home/ayushd/R2-D2_workspace/zephyr/soc/nuvoton/numaker/Kconfig"
osource "/home/ayushd/R2-D2_workspace/zephyr/soc/nuvoton/npcx/Kconfig"
osource "/home/ayushd/R2-D2_workspace/zephyr/soc/nordic/Kconfig"
osource "/home/ayushd/R2-D2_workspace/zephyr/soc/neorv32/Kconfig"
osource "/home/ayushd/R2-D2_workspace/zephyr/soc/native/inf_clock/Kconfig"
osource "/home/ayushd/R2-D2_workspace/zephyr/soc/microchip/miv/Kconfig"
osource "/home/ayushd/R2-D2_workspace/zephyr/soc/microchip/mec/Kconfig"
osource "/home/ayushd/R2-D2_workspace/zephyr/soc/mediatek/mtk_adsp/Kconfig"
osource "/home/ayushd/R2-D2_workspace/zephyr/soc/lowrisc/opentitan/Kconfig"
osource "/home/ayushd/R2-D2_workspace/zephyr/soc/litex/litex_vexriscv/Kconfig"
osource "/home/ayushd/R2-D2_workspace/zephyr/soc/ite/ec/Kconfig"
osource "/home/ayushd/R2-D2_workspace/zephyr/soc/intel/raptor_lake/Kconfig"
osource "/home/ayushd/R2-D2_workspace/zephyr/soc/intel/lakemont/Kconfig"
osource "/home/ayushd/R2-D2_workspace/zephyr/soc/intel/intel_socfpga_std/Kconfig"
osource "/home/ayushd/R2-D2_workspace/zephyr/soc/intel/intel_socfpga/Kconfig"
osource "/home/ayushd/R2-D2_workspace/zephyr/soc/intel/intel_niosv/Kconfig"
osource "/home/ayushd/R2-D2_workspace/zephyr/soc/intel/intel_ish/Kconfig"
osource "/home/ayushd/R2-D2_workspace/zephyr/soc/intel/intel_adsp/Kconfig"
osource "/home/ayushd/R2-D2_workspace/zephyr/soc/intel/elkhart_lake/Kconfig"
osource "/home/ayushd/R2-D2_workspace/zephyr/soc/intel/atom/Kconfig"
osource "/home/ayushd/R2-D2_workspace/zephyr/soc/intel/apollo_lake/Kconfig"
osource "/home/ayushd/R2-D2_workspace/zephyr/soc/intel/alder_lake/Kconfig"
osource "/home/ayushd/R2-D2_workspace/zephyr/soc/infineon/cat3/Kconfig"
osource "/home/ayushd/R2-D2_workspace/zephyr/soc/infineon/cat1b/Kconfig"
osource "/home/ayushd/R2-D2_workspace/zephyr/soc/infineon/cat1a/Kconfig"
osource "/home/ayushd/R2-D2_workspace/zephyr/soc/gd/gd32/Kconfig"
osource "/home/ayushd/R2-D2_workspace/zephyr/soc/gaisler/leon3/Kconfig"
osource "/home/ayushd/R2-D2_workspace/zephyr/soc/gaisler/gr716a/Kconfig"
osource "/home/ayushd/R2-D2_workspace/zephyr/soc/espressif/Kconfig"
osource "/home/ayushd/R2-D2_workspace/zephyr/soc/ene/kb1200/Kconfig"
osource "/home/ayushd/R2-D2_workspace/zephyr/soc/efinix/sapphire/Kconfig"
osource "/home/ayushd/R2-D2_workspace/zephyr/soc/cdns/xtensa_sample_controller/Kconfig"
osource "/home/ayushd/R2-D2_workspace/zephyr/soc/cdns/dc233c/Kconfig"
osource "/home/ayushd/R2-D2_workspace/zephyr/soc/brcm/bcmvk/Kconfig"
osource "/home/ayushd/R2-D2_workspace/zephyr/soc/brcm/bcm2712/Kconfig"
osource "/home/ayushd/R2-D2_workspace/zephyr/soc/brcm/bcm2711/Kconfig"
osource "/home/ayushd/R2-D2_workspace/zephyr/soc/atmel/sam0/Kconfig"
osource "/home/ayushd/R2-D2_workspace/zephyr/soc/atmel/sam/Kconfig"
osource "/home/ayushd/R2-D2_workspace/zephyr/soc/aspeed/Kconfig"
osource "/home/ayushd/R2-D2_workspace/zephyr/soc/arm/Kconfig"
osource "/home/ayushd/R2-D2_workspace/zephyr/soc/arm/beetle/Kconfig"
osource "/home/ayushd/R2-D2_workspace/zephyr/soc/andestech/Kconfig"
osource "/home/ayushd/R2-D2_workspace/zephyr/soc/ambiq/Kconfig"
osource "/home/ayushd/R2-D2_workspace/zephyr/soc/altr/zephyr_nios2f/Kconfig"
osource "/home/ayushd/R2-D2_workspace/zephyr/soc/altr/qemu_nios2/Kconfig"
osource "/home/ayushd/R2-D2_workspace/zephyr/soc/adi/max32/Kconfig"
```

## west.yml
```yaml
manifest:

  projects:
    - name: zephyr
      url: https://github.com/zephyrproject-rtos/zephyr
      revision: v4.2.0
      path: zephyr
      west-commands: scripts/west-commands.yml
      import: 
        name-allowlist:
          - cmsis
          - cmsis_6
          - hal_stm32
          - hal_rpi_pico 
          - segger


    # - name: kyvernitis 
    #   url: https://github.com/waseemr02/kyvernitis
    #   revision: add-mother-inverse
    #   path: modules/lib/kyvernitis
    #   import: true

    - name: hal_st
      path: modules/hal/st
      url: https://github.com/zephyrproject-rtos/hal_st.git



  self:
    path: Tarzan
```

## zephyr/Kconfig
```kconfig
config Tarzan
	bool "Enable Tarzan"
	help
	  This option enables Tarzan as a Zephyr module.

config TARZAN_LOG_LEVEL
	int "Tarzan module log level"
	default 3
	range 0 4
	help
	  Sets the compile-time log level for the Tarzan module.
	  0 = OFF, 1 = ERR, 2 = WRN, 3 = INF, 4 = DBG.
```
