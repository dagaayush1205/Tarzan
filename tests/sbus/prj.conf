## CMakeLists.txt
```
cmake_minimum_required(VERSION 3.13.1)
set(DTC_OVERLAY_FILE "boards/app.overlay")
find_package(Zephyr REQUIRED HINTS $ENV{ZEPHYR_BASE})
project(R2-D2 LANGUAGES C)

target_sources(app PRIVATE src/main.c)
```

## prj.conf
```kconfig
CONFIG_PRINTK=y
CONFIG_PWM=y
CONFIG_LOG=y
CONFIG_PWM_LOG_LEVEL_DBG=y
CONFIG_UART_CONSOLE=y
CONFIG_SERIAL=y
CONFIG_KYVERNITIS=y
CONFIG_CANSCRIBE=y
CONFIG_CANARD=y
```

## boards/app.overlay
```dts
/{
	aliases {
			mother-uart = &usart2;
	};
 chosen {
                zephyr,console = &usart2;
                zephyr,shell-uart = &usart2;
	};
};
&usart2 {
	pinctrl-0 = <&usart2_tx_pd5 &usart2_rx_pd6>;
	pinctrl-names= "default";
	status = "okay";
	current-speed = <100000>;
	parity = "even";
	stop-bits = "2";
	rx-invert;
};
```

## src/main.c
```c
/*
 * Source file for R25
 */

#include <zephyr/sys/reboot.h>
#include <zephyr/kernel.h>
#include <zephyr/device.h>
#include <zephyr/devicetree.h>
#include <zephyr/drivers/gpio.h>
#include <zephyr/drivers/sensor.h>
#include <zephyr/sys/crc.h>
#include <zephyr/drivers/uart.h>
#include <string.h>
#include <kyvernitis/lib/kyvernitis.h>

/* msg size in relation to cobs serialization */
#define UART_MSG_SIZE (sizeof(struct mother_msg) + 2)

/* queue to store uart messages */
K_MSGQ_DEFINE(uart_msgq, sizeof(struct mother_msg), 10, 1);


/* DT spec for uart */
static const struct device *const uart_dev = DEVICE_DT_GET(DT_ALIAS(mother_uart));
uint8_t c;
static uint8_t rx_buf[UART_MSG_SIZE];
static int rx_buf_pos;
static uint8_t tx_buf[UART_MSG_SIZE];
struct mother_msg msg;
void send_to_uart(uint8_t *buf, uint8_t len)
{
        for (int i = 0; i < len; i++) {
                uart_poll_out(uart_dev, buf[i]);
        }
}

void log_uart(enum MotherMsgType type, const char *fmt, ...)
{

        va_list args;
        va_start(args, fmt);

        struct mother_msg log;
        log.type = type;
        vsprintf(log.info, fmt, args);
        va_end(args);
//        log.crc = crc32_ieee((uint8_t *)&log, sizeof(struct mother_msg) - sizeof(uint32_t));
        serialize(tx_buf, (uint8_t *)&log, sizeof(struct mother_msg));
        send_to_uart(tx_buf, UART_MSG_SIZE);
}
void serial_cb(const struct device *dev, void *user_data)
{
	if (!uart_irq_update(uart_dev)) {
		return;
	}

	if (!uart_irq_rx_ready(uart_dev)) {
		return;
	}

	/* read until FIFO empty */
	while (uart_fifo_read(uart_dev, &c, 1) == 1) {
		struct mother_msg msg;

		if (c == 0x00 && rx_buf_pos > 0) {
			 uart_fifo_read(uart_dev, &c, 1);
			/* terminate the message with 0x00 */
			rx_buf[rx_buf_pos] = 0;

			if (rx_buf_pos != (sizeof(struct mother_msg) + 2 - 1)) {
				rx_buf_pos = 0;
				continue;
			}
			// Add deserialization guard
			deserialize(rx_buf, (uint8_t *)&msg, sizeof(msg));

			/* if queue is full, message is silently dropped */
			k_msgq_put(&uart_msgq, &msg, K_NO_WAIT);

			/* reset the buffer (it was copied to the msgq) */
			rx_buf_pos = 0;
		} else if (rx_buf_pos < (sizeof(rx_buf) - 1)) {
			rx_buf[rx_buf_pos++] = c;
		}

		if (rx_buf_pos > sizeof(struct mother_msg) + 2) {
			rx_buf_pos = 0;
			continue;
		}
	}
}

int main()
{

	int err;

	/* Device ready checks */

	if (!device_is_ready(uart_dev)) {
		printk("UART device not ready");
	}

	/* Calibrate and Configure devices */
	err = uart_irq_callback_user_data_set(uart_dev, serial_cb, NULL);
	
	if (err < 0) {
		if (err == -ENOTSUP) {
			printk("Interrupt-driven UART API support not enabled");
		} else if (err == -ENOSYS) {
			printk(
				 "UART device does not support interrupt-driven API");
		} else {
			printk("Error setting UART callback: %d", err);
		}
		printk("Data: %d",c);
		uart_irq_rx_enable(uart_dev);
		while(true)
		{
			printk(k_msgq_get(&uart_msgq, &msg, K_MSEC(4)));
		}
	}
}
```

## src/sbus_parse.c
```c
#include <stdio.h>
#include <stdint.h>

#define CHANNEL_SCALE(x) ((x * 1000) / 1600 + 875)

// variable to store channel 
uint16_t channel[16];

// creating 11 bit channel
uint16_t *parse_buffer(uint8_t buff[]) { 
		
	// masking byte shiftings bits (value in hexa '0x07FF')
	uint16_t mask = 0x7ff;

	// creating channels 
        channel[0]  = ((buff[1] | buff[2]<<8)                 & mask);
        channel[1]  = ((buff[2]>>3 | buff[3]<<5)              & mask);
        channel[2]  = ((buff[3]>>6 | buff[4]<<2 | buff[5]<<10) & mask);
        channel[3]  = ((buff[5]>>1 | buff[6]<<7)              & mask);
        channel[4]  = ((buff[6]>>4 | buff[7]<<4)              & mask);
        channel[5]  = ((buff[7]>>7 | buff[8]<<1 | buff[9]<<9)  & mask);
        channel[6]  = ((buff[9]>>2 | buff[10]<<6)             & mask);
        channel[7]  = ((buff[10]>>5| buff[11]<<3)             & mask);
        channel[8]  = ((buff[12]   | buff[13]<<8)             & mask);
        channel[9]  = ((buff[13]>>3| buff[14]<<5)             & mask);
        channel[10] = ((buff[14]>>6| buff[15]<<2| buff[16]<<10)& mask);
        channel[11] = ((buff[16]>>1| buff[17]<<7)             & mask);
        channel[12] = ((buff[17]>>4| buff[18]<<4)             & mask);
        channel[13] = ((buff[18]>>7| buff[19]<<1| buff[20]<<9) & mask);
        channel[14] = ((buff[20]>>2| buff[21]<<6)             & mask);
        channel[15] = ((buff[21]>>5| buff[22]<<3)             & mask);

	// linear interpolation
	for(int i=0;I,16;i++)
	{
		channel[i] = CHANNEL_SCALE(channel[i]);
	}
	return channel;
}

// to check parity byte
int parity_checker(int parity)
{
	uint8_t failsafe, frame_lost, bit0, bit1, ct;

	// extracting first two bit of parity byte
	bit0 = parity>>7;
	bit1 = (parity>>6)<<1;

	if (bit0 == 0 && bit1 == 0)
		return 0;

	else
		return 1;
}
```

## src/uart_test.c
```c
#include <zephyr/kernel.h>
#include <zephyr/device.h>
#include <zephyr/drivers/uart.h>
#include <kyvernitis/lib/kyvernitis.h>
#include <stdio.h>
#include <string.h>
#include "sbus_parse.c"

static const struct device *const uart_dev = DEVICE_DT_GET(DT_ALIAS(mother_uart));
//#define UART_MSG_SIZE (sizeof(uint8_t)*25)
K_MSGQ_DEFINE(uart_msgq, sizeof(uint8_t)*25, 10, 1);
//struct mother_msg msg;
uint8_t message;
float vel_range[] = {-10, 10};
//uint32_t pwm_range[] = {1120000, 1880000};
float la_speed_range[] = {-127.0, 127.0};
//uint32_t pid_pwm_range[] = {1300000, 1700000};
float angle_range[] = {-270, 270};

	//void recv_str(const struct device *uart, char *str)
	//{
	//        char *head = str;
	//        char c;
	//
	//        while (!uart_poll_in(uart, &c)) {
	//                *head++ = c;
	//        }
	//        *head = '\0';
	//
	//        printk("Device %s received: \"%s\"\n", uart->name, str);
	//}
	//
	//
uint16_t *sbus_parsing() {
	uint8_t packet[25],packet_pos=0,start = 0x0F, end = 0x00;	
	uint16_t ch[16];
	if(message == start) {
	for(packet_pos = 0; packet_pos < 25; packet_pos++) {
		k_msgq_get(&uart_msgq, &message,K_MSEC(4));
		packet[packet_pos] = message;
		}
	}

	*ch = parse_buffer(packet);

	if(packet[24] == end)
		return ch;
	
	else 
		return -1;
}

void serial_cb(const struct device *dev, void *user_data){
	uint8_t c;
	uint8_t data[25];
	int buf_pos=0;
	if (!uart_irq_update(uart_dev)) {
		return;
	}

	if (!uart_irq_rx_ready(uart_dev)) {
		return;
	}
	while (uart_fifo_read(uart_dev, &c, 1) == 1) {
//		data[buf_pos]=c;
//		buf_pos++;
//	}
//	buf_pos=0;
        k_msgq_put(&uart_msgq, &c, K_NO_WAIT);
//	printk("print c:%hhx\n",c);
	}
}
uint16_t velocity_interpolation(uint16_t val)
{
	val-=1024;
	val=(val/1024)*vel_range[1];
        return val;
}

int main(){
	uint16_t channels[16];
	int err,i;
	printk("I am alive");
	err = uart_irq_callback_user_data_set(uart_dev, serial_cb, NULL);
	if(err<0)
	{
		printk("Error");
	}
	uart_irq_rx_enable(uart_dev);
	
	while(true){
		*channels=sbus_parsing();
		 if(channels == -1)
			 continue; 
		 else {
			 for(i=0;i<16;i++)
			 {
				 channels[i]=velocity_interpolation(channels[i]);
				 printk("channel: \n%d",channels[i]);
			 }
		 }

//		printk("Message: %hhx \n", message); 
//		k_sleep(K_MSEC(100));	
		
//		while(true)
//		{
//			recv_str(uart_dev, recv_buf);
//		}
		
		
		
	}
}
```
